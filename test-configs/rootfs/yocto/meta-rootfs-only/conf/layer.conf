## test-configs/rootfs/yocto/meta-rootfs-only/conf/layer.conf
```bitbake
# layer.conf for meta-rootfs-only
BBPATH .= ":${LAYERDIR}"
BBFILES += "${LAYERDIR}/recipes-*/*/*.bb \
	${LAYERDIR}/recipes-*/*/*.bbappend"

LAYERSERIES_COMPAT_meta-rootfs-only = "honister kirkstone langdale mickledore nanbield scarthgap"
```
